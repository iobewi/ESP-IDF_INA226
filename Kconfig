## Kconfig
```kconfig
menu "INA226 Power Monitor Configuration"
    
    menu "INA226 Measurement Configuration"
    
        config INA226_SHUNT_RESISTANCE_MILLIOHM
            int "Shunt resistor value (in milliohms)"
            range 1 1000
            default 100
        
        choice INA226_AVERAGING
            prompt "Averaging count"
            default INA226_AVG_1
        
        config INA226_AVG_1
            bool "1 sample"
        config INA226_AVG_4
            bool "4 samples"
        config INA226_AVG_16
            bool "16 samples"
        config INA226_AVG_64
            bool "64 samples"
        config INA226_AVG_128
            bool "128 samples"
        config INA226_AVG_256
            bool "256 samples"
        config INA226_AVG_512
            bool "512 samples"
        config INA226_AVG_1024
            bool "1024 samples"
        
        endchoice
        
        choice INA226_BUS_CONV_TIME
            prompt "Bus Voltage Conversion Time"
            default INA226_BUS_CT_1100US
        
        config INA226_BUS_CT_140US
            bool "140 µs"
        config INA226_BUS_CT_204US
            bool "204 µs"
        config INA226_BUS_CT_332US
            bool "332 µs"
        config INA226_BUS_CT_588US
            bool "588 µs"
        config INA226_BUS_CT_1100US
            bool "1100 µs"
        config INA226_BUS_CT_2116US
            bool "2116 µs"
        config INA226_BUS_CT_4156US
            bool "4156 µs"
        config INA226_BUS_CT_8244US
            bool "8244 µs"
        
        endchoice
        
        choice INA226_SHUNT_CONV_TIME
            prompt "Shunt Voltage Conversion Time"
            default INA226_SHUNT_CT_1100US
        
        config INA226_SHUNT_CT_140US
            bool "140 µs"
        config INA226_SHUNT_CT_204US
            bool "204 µs"
        config INA226_SHUNT_CT_332US
            bool "332 µs"
        config INA226_SHUNT_CT_588US
            bool "588 µs"
        config INA226_SHUNT_CT_1100US
            bool "1100 µs"
        config INA226_SHUNT_CT_2116US
            bool "2116 µs"
        config INA226_SHUNT_CT_4156US
            bool "4156 µs"
        config INA226_SHUNT_CT_8244US
            bool "8244 µs"
        
        endchoice
        
        config INA226_ALERT_MASK
            hex "Alert Mask register (hex)"
            default 0x0000
        
    endmenu

    menu "INA226 I2C Interface"
        
        config INA226_I2C_ADDRESS
            hex "I2C hardware address"
            default 0x40
            help
                INA226 default I2C address is 0x40
        
        config INA226_I2C_MASTER_PORT_NUM
            int "I2C Port Number"
            default 0
            help
                I2C port index used by the Master
        
        config INA226_I2C_MASTER_FREQUENCY
            int "I2C Clock Frequency (Hz)"
            default 100000
            help
                Frequency for I2C Master operations
        
        config INA226_INT_ALERT
            int "INT GPIO Number"
            range ENV_GPIO_RANGE_MIN ENV_GPIO_OUT_RANGE_MAX
            default 12
            help
                GPIO used for INA226 ALERT pin
    
    endmenu
    
endmenu
    
```
